## build/Kconfig/arch/Kconfig.tmp
```kconfig
# Load Zephyr Arch Kconfig descriptions.
osource "/home/ihn/zephyrproject/zephyr/arch/rx/Kconfig"
osource "/home/ihn/zephyrproject/zephyr/arch/x86/Kconfig"
osource "/home/ihn/zephyrproject/zephyr/arch/xtensa/Kconfig"
osource "/home/ihn/zephyrproject/zephyr/arch/sparc/Kconfig"
osource "/home/ihn/zephyrproject/zephyr/arch/riscv/Kconfig"
osource "/home/ihn/zephyrproject/zephyr/arch/posix/Kconfig"
osource "/home/ihn/zephyrproject/zephyr/arch/openrisc/Kconfig"
osource "/home/ihn/zephyrproject/zephyr/arch/mips/Kconfig"
osource "/home/ihn/zephyrproject/zephyr/arch/arm64/Kconfig"
osource "/home/ihn/zephyrproject/zephyr/arch/arm/Kconfig"
osource "/home/ihn/zephyrproject/zephyr/arch/arc/Kconfig"
```

## build/Kconfig/boards/Kconfig
```kconfig
# Load Zephyr board Kconfig descriptions.
osource "/home/ihn/zephyrproject/zephyr/boards/st/nucleo_g474re/Kconfig"
```

## build/Kconfig/boards/Kconfig.defconfig.tmp
```kconfig
# Load Zephyr board defconfig descriptions.
osource "/home/ihn/zephyrproject/zephyr/boards/st/nucleo_g474re/Kconfig.defconfig"
```

## build/Kconfig/boards/Kconfig.nucleo_g474re.tmp
```kconfig
# Load board Kconfig descriptions.
osource "/home/ihn/zephyrproject/zephyr/boards/st/nucleo_g474re/Kconfig.nucleo_g474re"
```
